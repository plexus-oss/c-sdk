## examples/esp32_flashable/sdkconfig.defaults
```kconfig
# Plexus Flashable Firmware - ESP-IDF Configuration
# Use custom partition table with plexus_cfg NVS partition
CONFIG_PARTITION_TABLE_CUSTOM=y
CONFIG_PARTITION_TABLE_CUSTOM_FILENAME="partitions.csv"
CONFIG_PARTITION_TABLE_FILENAME="partitions.csv"

# WiFi
CONFIG_ESP_WIFI_SSID=""
CONFIG_ESP_WIFI_PASSWORD=""

# NVS
CONFIG_NVS_ENCRYPTION=n

# SNTP for time sync
CONFIG_LWIP_SNTP_MAX_SERVERS=1

# HTTP client (for Plexus SDK)
CONFIG_ESP_HTTP_CLIENT_ENABLE_HTTPS=y

# TLS (required for HTTPS to Plexus)
CONFIG_ESP_TLS_USING_MBEDTLS=y
CONFIG_MBEDTLS_CERTIFICATE_BUNDLE=y
CONFIG_MBEDTLS_CERTIFICATE_BUNDLE_DEFAULT_FULL=y

# Stack sizes
CONFIG_ESP_MAIN_TASK_STACK_SIZE=8192
CONFIG_ESP_SYSTEM_EVENT_TASK_STACK_SIZE=4096

# Optimization
CONFIG_COMPILER_OPTIMIZATION_SIZE=y

# Plexus SDK options
CONFIG_PLEXUS_ENABLE_PERSISTENT_BUFFER=y
```

## firmware/sdkconfig.defaults
```kconfig
# Plexus Generic Firmware — ESP-IDF configuration defaults
#
# These are applied on first build. Override in sdkconfig.defaults.{target}
# or via menuconfig (idf.py menuconfig).

# ── Partition table ──────────────────────────────────────────────────────────
CONFIG_PARTITION_TABLE_CUSTOM=y
CONFIG_PARTITION_TABLE_CUSTOM_FILENAME="partitions.csv"

# ── NVS encryption ──────────────────────────────────────────────────────────
CONFIG_NVS_ENCRYPTION=y

# ── WiFi ─────────────────────────────────────────────────────────────────────
CONFIG_ESP_WIFI_SSID=""
CONFIG_ESP_WIFI_PASSWORD=""

# ── TLS / mbedTLS ────────────────────────────────────────────────────────────
CONFIG_MBEDTLS_CERTIFICATE_BUNDLE=y
CONFIG_MBEDTLS_CERTIFICATE_BUNDLE_DEFAULT_FULL=y

# ── FreeRTOS ─────────────────────────────────────────────────────────────────
CONFIG_FREERTOS_HZ=1000

# ── UART ─────────────────────────────────────────────────────────────────────
# Keep UART0 available for serial provisioning (not used for debug in release)
CONFIG_ESP_CONSOLE_UART_NUM=0

# ── Flash encryption (documented — enable for production) ────────────────────
# CONFIG_SECURE_FLASH_ENC_ENABLED is NOT set (enable manually for production)

# ── Secure boot (documented — enable for production) ─────────────────────────
# CONFIG_SECURE_BOOT is NOT set (enable manually for production — irreversible)

# ── Watchdog ─────────────────────────────────────────────────────────────────
CONFIG_ESP_TASK_WDT_TIMEOUT_S=10

# ── Log level ────────────────────────────────────────────────────────────────
CONFIG_LOG_DEFAULT_LEVEL_INFO=y

# ── SNTP ─────────────────────────────────────────────────────────────────────
CONFIG_LWIP_SNTP_MAX_SERVERS=2
```
